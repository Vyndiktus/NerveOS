## br2-external/Config.in
```kconfig
source "$BR2_EXTERNAL_NERVEOS_PATH/package/nerved/Config.in"
source "$BR2_EXTERNAL_NERVEOS_PATH/package/python-rns/Config.in"
```

## br2-external/configs/NerveOS_cepheus_defconfig
```kconfig
# NerveOS — Xiaomi Mi 9 (cepheus) Buildroot configuration
# Target: Qualcomm Snapdragon 855 (SM8150), ARM64 (aarch64)
# Buildroot: 2024.02

# ── Architecture ─────────────────────────────────────────────────
BR2_aarch64=y

# ── Toolchain — Bootlin prebuilt (aarch64 glibc, stable) ─────────
BR2_TOOLCHAIN_EXTERNAL=y
BR2_TOOLCHAIN_EXTERNAL_BOOTLIN=y
BR2_TOOLCHAIN_EXTERNAL_BOOTLIN_AARCH64_GLIBC_STABLE=y

# ── Kernel — sm8150-mainline 6.11 ────────────────────────────────
BR2_LINUX_KERNEL=y
BR2_LINUX_KERNEL_CUSTOM_GIT=y
BR2_LINUX_KERNEL_CUSTOM_REPO_URL="https://github.com/map220v/sm8150-mainline"
BR2_LINUX_KERNEL_CUSTOM_REPO_VERSION="4a8d88483"
BR2_LINUX_KERNEL_USE_CUSTOM_CONFIG=y
BR2_LINUX_KERNEL_CUSTOM_CONFIG_FILE="$(BR2_EXTERNAL_NERVEOS_PATH)/board/cepheus/linux-mainline.config"
BR2_LINUX_KERNEL_PATCH="$(BR2_EXTERNAL_NERVEOS_PATH)/board/cepheus/linux-patches-mainline"
BR2_LINUX_KERNEL_IMAGE_TARGET_NAME="Image"
BR2_LINUX_KERNEL_DTS="qcom/sm8150-xiaomi-cepheus"
BR2_LINUX_KERNEL_NEEDS_HOST_OPENSSL=y
BR2_LINUX_KERNEL_CONFIG_FRAGMENT_FILES="$(BR2_EXTERNAL_NERVEOS_PATH)/board/cepheus/kernel-nerveos-mainline.config"

# ── System ───────────────────────────────────────────────────────
BR2_TARGET_GENERIC_HOSTNAME="nerveos"
BR2_TARGET_GENERIC_ISSUE="NerveOS 0.1"
BR2_INIT_SYSV=y
BR2_ROOTFS_DEVICE_CREATION_DYNAMIC_EUDEV=y

# ── Filesystem — ext4 rootfs image ──────────────────────────────
BR2_TARGET_ROOTFS_EXT2=y
BR2_TARGET_ROOTFS_EXT2_4=y
BR2_TARGET_ROOTFS_EXT2_SIZE="2048M"

# ── Rootfs overlay ───────────────────────────────────────────────
BR2_ROOTFS_OVERLAY="$(BR2_EXTERNAL_NERVEOS_PATH)/../rootfs-overlay"
BR2_ROOTFS_POST_BUILD_SCRIPT="$(BR2_EXTERNAL_NERVEOS_PATH)/board/cepheus/post-build.sh"

# ── Base system ──────────────────────────────────────────────────
BR2_PACKAGE_BUSYBOX=y
BR2_PACKAGE_E2FSPROGS=y
BR2_PACKAGE_UTIL_LINUX=y
BR2_PACKAGE_DROPBEAR=y

# ── Networking ───────────────────────────────────────────────────
BR2_PACKAGE_WIREGUARD_TOOLS=y
BR2_PACKAGE_OPENSSL=y
BR2_PACKAGE_DHCPCD=y
BR2_PACKAGE_WPA_SUPPLICANT=y
BR2_PACKAGE_IW=y
BR2_PACKAGE_NFTABLES=y
BR2_PACKAGE_IPROUTE2=y

# ── BATMAN-adv mesh transport ────────────────────────────────────
BR2_PACKAGE_BATCTL=y

# ── Bluetooth ────────────────────────────────────────────────────
BR2_PACKAGE_BLUEZ5_UTILS=y
BR2_PACKAGE_BLUEZ5_UTILS_TOOLS=y

# ── WiFi firmware (ath10k WCN3990) ───────────────────────────────
BR2_PACKAGE_LINUX_FIRMWARE=y
BR2_PACKAGE_LINUX_FIRMWARE_ATHEROS_ATH10K=y

# ── Python 3 — Reticulum transport ───────────────────────────────
BR2_PACKAGE_PYTHON3=y
BR2_PACKAGE_PYTHON_CRYPTOGRAPHY=y
BR2_PACKAGE_PYTHON_SERIAL=y
BR2_PACKAGE_PYTHON_RNS=y

# ── NerveOS daemon ───────────────────────────────────────────────
BR2_PACKAGE_NERVED=y

# ── Host tools ───────────────────────────────────────────────────
BR2_PACKAGE_HOST_GO=y
BR2_PACKAGE_HOST_OPENSSL=y
BR2_PACKAGE_HOST_MKIMAGE=y
```

## br2-external/package/nerved/Config.in
```kconfig
config BR2_PACKAGE_NERVED
	bool "nerved"
	depends on BR2_PACKAGE_HOST_GO_TARGET_ARCH_SUPPORTS
	depends on BR2_TOOLCHAIN_HAS_THREADS
	select BR2_PACKAGE_WIREGUARD_TOOLS
	help
	  NerveOS daemon — manages mesh networking, peer discovery,
	  and distributed resource sharing across the hive.
```

## br2-external/package/python-rns/Config.in
```kconfig
config BR2_PACKAGE_PYTHON_RNS
	bool "python-rns"
	depends on BR2_PACKAGE_PYTHON3
	select BR2_PACKAGE_PYTHON_CRYPTOGRAPHY
	select BR2_PACKAGE_PYTHON_SERIAL
	help
	  Reticulum Network Stack (RNS) — a cryptography-based networking
	  stack for building unstoppable networks with LoRa, WiFi, BATMAN-adv,
	  packet radio, and anything in between.

	  Provides rnsd (daemon), rnstatus, rnpath, and the RNS Python API
	  used by nerved for multi-transport peer discovery.

	  https://github.com/markqvist/Reticulum
```
